## drivers/misc/mediatek/alsps/em3071x/Kconfig
```kconfig
config MTK_EM3071X
	bool "em3071x for MediaTek package"
	default n
	help
	It support different type sensor
	in this platform. If this option
	is set, it will support ambient
	and light sensor em3071x.
```

## drivers/misc/mediatek/aw8155_pixi4_5/Kconfig
```kconfig
config EXT_PA_AW8155_PIXI4_5
	bool "External PA Support for pixi4_5 project"
	default n
```

## drivers/misc/mediatek/fc8180/Kconfig
```kconfig
config DTV_SUPPORT_PIXI4_5
	bool "DTV fc8180 Support for pixi4_5 project"
	default n
```
